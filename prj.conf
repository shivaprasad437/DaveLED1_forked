## CMakeLists.txt
```
# SPDX-License-Identifier: Apache-2.0

cmake_minimum_required(VERSION 3.20.0)

find_package(Zephyr REQUIRED HINTS $ENV{ZEPHYR_BASE})
project(hello_world)

target_sources(app PRIVATE 
    src/main.cpp
    src/Test.c
    src/TestCPP.cpp
)
zephyr_include_directories(
    src
)
#just added some comment to see how commit works in git
```

## prj.conf
```kconfig
CONFIG_CPLUSPLUS=y
CONFIG_PRINTK=y
CONFIG_LOG_PRINTK=y
CONFIG_LOG=y
CONFIG_LOG_BACKEND_RTT=y
```

## src/main.c
```c
/*
 * Copyright (c) 2012-2014 Wind River Systems, Inc.
 *
 * SPDX-License-Identifier: Apache-2.0
 */

#include <zephyr.h>
#include <time.h>
#include <device.h>
#include <drivers/gpio.h>

#include <Test.h>
#include <TestCPP.hpp>

#define LED_1_NODE DT_ALIAS(led1)
void main(void)
{
    static bool isOn = false;
    static int counter = 0;
    const struct gpio_dt_spec led_1 = GPIO_DT_SPEC_GET(LED_1_NODE, gpios);

    gpio_pin_configure_dt(&led_1, GPIO_OUTPUT_ACTIVE);

    while (true) {
        k_sleep(K_MSEC(1000));
        printk("%-5d squared = %-5d\t %s\n", counter, squareIt(counter++), isOn ? "ON" : "off");
        k_sleep(K_MSEC(3)); // <== this delay is required at >= 2-3ms or greater to avoid aparent tow printk's every 2 seconds
        isOn = !isOn;
        gpio_pin_set_dt(&led_1, isOn);
    }
}
```

## src/main.cpp
```c
/*
 * Copyright (c) 2012-2014 Wind River Systems, Inc.
 *
 * SPDX-License-Identifier: Apache-2.0
 */

#include <zephyr.h>
#include <time.h>
#include <device.h>
#include <drivers/gpio.h>

#include <Test.h>
#include <TestCPP.h>

#define LED_1_NODE DT_ALIAS(led1)

extern "C" {
void main(void)
{
    static bool isOn = false;
    static int counter = 0;
    const struct gpio_dt_spec led_1 = GPIO_DT_SPEC_GET(LED_1_NODE, gpios);

    gpio_pin_configure_dt(&led_1, GPIO_OUTPUT_ACTIVE);

    while (true) {
        k_sleep(K_MSEC(1000));
        printk("%-5d squared = %-5d\t %s\n", counter, squareIt(counter++), isOn ? "ON" : "off");
        k_sleep(K_MSEC(3)); // <== this delay is required at >= 2-3ms or greater to avoid aparent tow printk's every 2 seconds
        isOn = !isOn;
        gpio_pin_set_dt(&led_1, isOn);
    }
}
}
```

## src/Test.c
```c
int squareIt(int i) {
    return i * i;
}
```

## src/Test.h
```c
extern "C" {
int squareIt(int i);
}
```

## src/TestCPP.cpp
```c
#include <TestCPP.h>

int foo::fooSquareIt(int i) {
    return i * i;
}
```

## src/TestCPP.h
```c
// class foo {

// public:
//     foo(int bar)   {
//         _bar = bar;
//     };
//     int getSquareTimesBar(int i) { return i * i * _bar;    }

// private:
//     int _bar;
// }
```

## src/TestCPP.hpp
```c
#include <zephyr.h>

class foo
{
public:
    foo(void);
    int fooSquareIt(int i);

private:
    int _bar;
};
```
