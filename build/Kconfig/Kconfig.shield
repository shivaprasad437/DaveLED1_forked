## build/Kconfig/Kconfig.shield
```kconfig
osource "/Users/davidelvig/Desktop/DesktopSrc/DaveLED1/boards/shields/*/Kconfig.shield"
osource "/opt/nordic/ncs/v2.0.0/nrf/boards/shields/*/Kconfig.shield"
```

## build/Kconfig/Kconfig.shield.defconfig
```kconfig
osource "/Users/davidelvig/Desktop/DesktopSrc/DaveLED1/boards/shields/*/Kconfig.defconfig"
osource "/opt/nordic/ncs/v2.0.0/nrf/boards/shields/*/Kconfig.defconfig"
```
